VERSION ""

NS_ :

BS_:

BU_:

BO_ 688 SAS11_FS: 6 Vector__XXX
 SG_ SAS_Speed : 16|8@1- (4,0) [0|1016] "" Vector__XXX

BO_ 593 MDPS12_FS: 8 Vector__XXX
 SG_ CR_Mdps_StrTq : 0|11@1+ (0.0078125,-8) [-8|7.9921875] "Nm" Vector__XXX

BO_ 897 MDPS13_FS: 8 Vector__XXX
 SG_ CR_Mdps_OutTq : 11|12@1+ (0.01,-20.48) [-20.48|20.47] "Nm" Vector__XXX

CM_ SG_ 608 ENG_STAT "In case of DelPhi ECU. Output period tolerance(+1ms) will be applied to Engine Lamda3.";
CM_ SG_ 870 VS "PT-CAN EMS11 Indirect routing message in case of Delphi ECU, Output period tolerance(+1ms) will be applied to engine Lamda3.";
CM_ SG_ 688 SAS_Angle "When MDPS ECU sends this message, this message value is valid from IG-ON";
CM_ SG_ 593 CR_Mdps_StrTq "PH>0 : Left Direction(CCW)
PH<0 : Right Direction(CW)";
BA_DEF_ BO_  "CANFD_BRS" ENUM  "0","1";
BA_DEF_  "DBName" STRING ;
BA_DEF_  "BusType" STRING ;
BA_DEF_ BO_  "VFrameFormat" ENUM  "StandardCAN","ExtendedCAN","reserved","reserved","reserved","reserved","reserved","reserved","reserved","reserved","reserved","reserved","reserved","reserved","StandardCAN_FD","ExtendedCAN_FD";
BA_DEF_DEF_  "CANFD_BRS" "1";
BA_DEF_DEF_  "DBName" "";
BA_DEF_DEF_  "BusType" "";
BA_DEF_DEF_  "VFrameFormat" "StandardCAN";
BA_ "BusType" "CAN FD";
BA_ "DBName" "MDPS";
BA_ "VFrameFormat" BO_ 608 14;
BA_ "VFrameFormat" BO_ 870 14;
BA_ "VFrameFormat" BO_ 688 14;
BA_ "VFrameFormat" BO_ 593 14;
